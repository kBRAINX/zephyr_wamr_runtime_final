## CMakeLists.txt
```
cmake_minimum_required(VERSION 3.20.0)

# ============================================================================
# CMakeLists.txt — Firmware WAMR multi-transport
#
# Deux responsabilites :
#  1. Detecter automatiquement l'architecture cible de WAMR d'apres la carte
#     (aucune valeur figee : fonctionne sur Xtensa, RISC-V, ARM...).
#  2. Compiler le bon backend de transport (Wi-Fi ou BLE) selon la config,
#     et refuser explicitement une config sans transport.
#  3. (MAJ) Compiler le recepteur d'upload reseau src/net_upload.c (actif en
#     Wi-Fi seulement, vide en BLE).
# ============================================================================

set(WAMR_ROOT_DIR ${CMAKE_CURRENT_SOURCE_DIR}/../wasm-micro-runtime)

# --- Reglages WAMR indispensables sur cible contrainte ---
set(WAMR_BUILD_PLATFORM "zephyr")
set(WAMR_BUILD_INTERP 1)
set(WAMR_BUILD_AOT 0)
set(WAMR_BUILD_JIT 0)
set(WAMR_BUILD_LIBC_BUILTIN 1)
set(WAMR_BUILD_LIBC_WASI 0)
set(WAMR_BUILD_FAST_INTERP 1)
set(WAMR_BUILD_MULTI_MODULE 0)
set(WAMR_BUILD_SHARED_MEMORY 0)
set(WAMR_BUILD_THREAD_MGR 0)
# Memoire lineaire non "shrunk" : sinon ~1 Mo/module, fatal ici.
set(WAMR_BUILD_SHRUNK_MEMORY 0)

find_package(Zephyr REQUIRED HINTS $ENV{ZEPHYR_BASE})
project(wamr_multitransport)

# ----------------------------------------------------------------------------
# (SIMULATION) Choix du profil d'equipement au build :
#   west build ... -- -DSIM_EQUIP_ID=3
# Transmet la valeur au preprocesseur C (macro SIM_EQUIP_ID dans host_api.c).
# Sans -D, le defaut #ifndef SIM_EQUIP_ID -> 0 s'applique.
# ----------------------------------------------------------------------------
if(DEFINED SIM_EQUIP_ID)
  add_compile_definitions(SIM_EQUIP_ID=${SIM_EQUIP_ID})
  message(STATUS "SIMULATION : profil equipement = ${SIM_EQUIP_ID}")
endif()

# ----------------------------------------------------------------------------
# 1. DETECTION AUTOMATIQUE DE L'ARCHITECTURE WAMR
#
# Les symboles CONFIG_* sont disponibles APRES find_package(Zephyr).
# On respecte un choix explicite de l'utilisateur s'il en fournit un.
# ----------------------------------------------------------------------------
if(NOT DEFINED WAMR_BUILD_TARGET)
  if(CONFIG_XTENSA)
    set(_WAMR_TARGET "XTENSA")
  elseif(CONFIG_RISCV)
    if(CONFIG_64BIT)
      set(_WAMR_TARGET "RISCV64")
    elseif(CONFIG_FPU)
      set(_WAMR_TARGET "RISCV32_ILP32F")
    else()
      set(_WAMR_TARGET "RISCV32_ILP32")
    endif()
  elseif(CONFIG_ARM64)
    set(_WAMR_TARGET "AARCH64")
  elseif(CONFIG_ARM)
    set(_WAMR_TARGET "THUMB")
  elseif(CONFIG_X86_64)
    set(_WAMR_TARGET "X86_64")
  elseif(CONFIG_X86)
    set(_WAMR_TARGET "X86_32")
  else()
    message(FATAL_ERROR
      "Architecture non reconnue pour WAMR. Definissez-la explicitement : "
      "west build ... -- -DWAMR_BUILD_TARGET=<XTENSA|RISCV32_ILP32|THUMB|...>")
  endif()
  set(WAMR_BUILD_TARGET ${_WAMR_TARGET})
endif()
message(STATUS "WAMR_BUILD_TARGET detecte automatiquement : ${WAMR_BUILD_TARGET}")

# ----------------------------------------------------------------------------
# 2. SELECTION DU BACKEND DE TRANSPORT
#
# Exactement un backend doit etre actif. On le verifie ici, tot, avec un
# message clair, plutot que de laisser echouer l'edition de liens.
# ----------------------------------------------------------------------------
if(CONFIG_WIFI AND CONFIG_BT)
  message(FATAL_ERROR
    "CONFIG_WIFI et CONFIG_BT sont tous deux actifs. Choisissez UN seul "
    "transport (conf/wifi.conf OU conf/ble.conf).")
elseif(CONFIG_WIFI)
  message(STATUS "Transport selectionne : Wi-Fi (TCP)")
elseif(CONFIG_BT)
  message(STATUS "Transport selectionne : Bluetooth LE (NUS)")
else()
  message(FATAL_ERROR
    "Aucun transport selectionne. Ajoutez au build :\n"
    "  -DEXTRA_CONF_FILE=conf/wifi.conf   (Wi-Fi)\n"
    "  ou -DEXTRA_CONF_FILE=conf/ble.conf (Bluetooth LE)")
endif()

# ----------------------------------------------------------------------------
# 3. Runtime WAMR (bibliotheque)
# ----------------------------------------------------------------------------
set(WAMR_ROOT_DIR ${CMAKE_CURRENT_SOURCE_DIR}/../wasm-micro-runtime)
include(${WAMR_ROOT_DIR}/build-scripts/runtime_lib.cmake)

add_library(vmlib STATIC ${WAMR_RUNTIME_LIB_SOURCE})
target_include_directories(vmlib PUBLIC
  ${WAMR_ROOT_DIR}/core/iwasm/include
  ${WAMR_ROOT_DIR}/core/shared/utils
)
target_link_libraries(vmlib PUBLIC zephyr_interface)

# IMPORTANT — dependance sur les en-tetes generes de Zephyr.
#
# Depuis Zephyr ~4.4, kernel.h inclut <zephyr/heap_constants.h>, un en-tete
# GENERE pendant le build (il n'existe pas dans l'arbre source). Une
# bibliotheque creee via add_library() comme vmlib est liee a
# zephyr_interface pour les chemins d'include, mais cela n'entraine PAS
# automatiquement une dependance d'ordonnancement sur la generation de ces
# en-tetes. Resultat : ninja peut compiler WAMR AVANT que heap_constants.h
# soit produit, d'ou l'erreur :
#   fatal error: zephyr/heap_constants.h: No such file or directory
#
# On force donc vmlib a attendre la cible qui genere ces en-tetes. Selon la
# version de Zephyr, cette cible s'appelle zephyr_generated_headers (recent)
# ou offsets_h (plus ancien). On ajoute celle(s) qui existe(nt).
if(TARGET zephyr_generated_headers)
  add_dependencies(vmlib zephyr_generated_headers)
endif()
if(TARGET offsets_h)
  add_dependencies(vmlib offsets_h)
endif()

# ----------------------------------------------------------------------------
# 4. Sources de l'application
#
# Les deux backends sont listes, mais chacun est neutralise en interne par ses
# propres gardes #if : seul le backend correspondant au transport actif produit
# du code. Les lister tous les deux inconditionnellement evite un piege CMake
# (un fichier compile "a vide" ne coute rien).
# ----------------------------------------------------------------------------
target_sources(app PRIVATE
  src/main.c
  src/host_api.c
  src/transport_wifi.c
  src/transport_ble.c
  src/net_upload.c
)

target_include_directories(app PRIVATE
  ${WAMR_ROOT_DIR}/core/iwasm/include
)
target_link_libraries(app PRIVATE vmlib)
```

## Kconfig
```
# Kconfig — options specifiques a l'application WAMR multi-transport
#
# Declare les symboles personnalises utilises dans prj.conf et les overlays
# de configuration. Sans ce fichier, Zephyr rejette CONFIG_WAMR_* comme
# "unknown symbol".

mainmenu "WAMR multi-transport metrics runtime"

config WAMR_NODE_DEVICE_NAME
	string "Nom unique de l'equipement (expose au module WASM)"
	default "zephyr_node"
	help
	  Identifiant du noeud, transmis au module WASM a l'execution via la
	  host function host_get_device_name. Jamais code en dur dans le .wasm.

config WAMR_NODE_DEVICE_TYPE
	string "Type / famille de l'equipement"
	default "generic"
	help
	  Categorie materielle informative (ex. esp32s3, esp32c6, stm32wb55).
	  Exposee via host_get_device_type.

config WAMR_NODE_OS_NAME
	string "Nom de l'OS hote"
	default "zephyr"
	help
	  Expose via host_get_os_name.

# --- Tailles memoire WAMR, ajustables par carte ---
# Permettent d'adapter l'empreinte a chaque equipement. Les cartes a large
# RAM (ESP32-S3, ESP32-C6) gardent les valeurs par defaut ; les cartes
# contraintes (NUCLEO-WB55RG, ~192 Ko de RAM) les reduisent dans leur
# fichier boards/<carte>.conf, sinon l'edition de liens deborde.

config WAMR_APP_POOL_SIZE_KB
	int "Taille du pool memoire WAMR (Ko)"
	default 112
	help
	  Doit contenir la memoire lineaire du module (64 Ko incompressibles)
	  plus les metadonnees WAMR. Minimum realiste : ~72 Ko.

config WAMR_APP_WASM_MAX_KB
	int "Taille max du binaire .wasm accepte (Ko)"
	default 12

config WAMR_APP_STACK_KB
	int "Taille de pile d'execution WAMR (Ko)"
	default 8

config WAMR_APP_HEAP_KB
	int "Taille du tas d'application WAMR (Ko)"
	default 16

config WAMR_WIFI_SSID
	string "SSID du point d'acces Wi-Fi"
	default "a26nguep-hotspot"
	depends on WIFI
	help
	  Utilise uniquement par le backend transport Wi-Fi. Sans effet en BLE.

config WAMR_WIFI_PSK
	string "Mot de passe Wi-Fi (PSK)"
	default "123456789"
	depends on WIFI
	help
	  Utilise uniquement par le backend transport Wi-Fi. Sans effet en BLE.

config WAMR_BATTERY_ADC
	bool "Activer la mesure de tension batterie (ADC)"
	default n
	help
	  Active la host function host_metric_battery_mv (M13), qui lit la
	  tension batterie via l'ADC. Nécessite un overlay carte définissant
	  le canal ADC dans le nœud "zephyr,user". Désactivé, la métrique
	  battery_mv vaut 0 (ex. carte alimentée par USB), et la régulation
	  énergétique PADRE reste inactive côté WASM.
	  
# Rattachement a l'arbre Kconfig de Zephyr (obligatoire).
source "Kconfig.zephyr"
```

## prj.conf
```kconfig
# prj.conf — configuration de BASE, NEUTRE vis-a-vis du transport
#
# ============================================================================
# POINT CENTRAL DE CETTE MISE A JOUR
# ============================================================================
# Ce fichier n'active NI le Wi-Fi, NI le Bluetooth. Le Wi-Fi n'est donc PAS
# une dependance stricte : le firmware compile sur n'importe quelle carte, y
# compris une carte sans Wi-Fi (comme le NUCLEO-WB55RG).
#
# Le transport est choisi en AJOUTANT un fichier de configuration au moment
# du build, via -DEXTRA_CONF_FILE :
#
#   Wi-Fi :  west build -b <carte_wifi> . -- -DEXTRA_CONF_FILE=conf/wifi.conf
#   BLE   :  west build -b <carte_ble>  . -- -DEXTRA_CONF_FILE=conf/ble.conf
#
# ============================================================================

# --- WAMR : gros pool global, indispensable sur cible contrainte ---
# (equivalent Kconfig du reglage WAMR_BUILD_SHRUNK_MEMORY / global heap)

# --- Console / logs : printk seul, sans le sous-systeme de log ---
CONFIG_PRINTK=y
CONFIG_CONSOLE=y
CONFIG_UART_CONSOLE=y
CONFIG_STDOUT_CONSOLE=y
CONFIG_SERIAL=y
CONFIG_UART_INTERRUPT_DRIVEN=y
CONFIG_LOG=n

# --- Memoire ---
CONFIG_MAIN_STACK_SIZE=8192
CONFIG_HEAP_MEM_POOL_SIZE=65536
CONFIG_SYSTEM_WORKQUEUE_STACK_SIZE=2048
CONFIG_COMMON_LIBC_MALLOC=y
CONFIG_COMMON_LIBC_MALLOC_ARENA_SIZE=8192

# --- Metriques M1/M7/M8 : statistiques d'ordonnancement ---
# Generique a toute architecture supportee par Zephyr.
CONFIG_THREAD_RUNTIME_STATS=y
CONFIG_THREAD_RUNTIME_STATS_USE_TIMING_FUNCTIONS=y
CONFIG_TIMING_FUNCTIONS=y

# --- Metrique M11 : nombre de threads actifs (detection de fuite) ---
CONFIG_THREAD_MONITOR=y

# --- Metrique M7 : occupation reelle de la pile ---
# INIT_STACKS pre-remplit les piles d'un motif temoin : c'est ce qui permet a
# k_thread_stack_space_get() de mesurer l'espace reellement inutilise.
# THREAD_STACK_INFO expose la taille/base de pile (k_thread_stack_size_get()).
CONFIG_INIT_STACKS=y
CONFIG_THREAD_STACK_INFO=y

# --- Optimisation pour la TAILLE ---
CONFIG_SIZE_OPTIMIZATIONS=y

# --- Retirer ce qui ne sert pas en production ---
CONFIG_LOG=n
CONFIG_ASSERT=n
CONFIG_BOOT_BANNER=n
CONFIG_PRINTK=y          # garder printk (host_print), c'est peu coûteux
CONFIG_THREAD_NAME=n

# --- Newlib nano (si la libc est utilisée) : plus compacte ---
CONFIG_NEWLIB_LIBC=y
CONFIG_NEWLIB_LIBC_NANO=y

# --- Identite du noeud (surchargeable par carte via un .conf dedie) ---
# Ces chaines sont exposees au module WASM a l'execution (jamais codees en
# dur dans le .wasm).
CONFIG_WAMR_NODE_DEVICE_NAME="zephyr_node"
CONFIG_WAMR_NODE_DEVICE_TYPE="generic"
CONFIG_WAMR_NODE_OS_NAME="zephyr"
```

## boards/nucleo_wb55rg.conf
```kconfig
# boards/nucleo_wb55rg.conf — reglages specifiques a la carte NUCLEO-WB55RG
#
# Applique AUTOMATIQUEMENT par Zephyr lorsqu'on compile pour nucleo_wb55rg,
# grace a son nom (mecanisme de configuration par carte). Ne definit QUE
# l'identite du noeud ; le transport (BLE) est choisi via conf/ble.conf.
#
# PREREQUIS MATERIEL IMPERATIF (voir docs/NUCLEO_WB55RG.md) :
# le coprocesseur radio M0+ doit avoir ete flashe au prealable avec le
# firmware "HCI Only" (STM32CubeProgrammer). Sans cela, bt_enable() echoue
# avec un kernel oops (HCI timeout) au demarrage. Ce n'est PAS un reglage
# logiciel : c'est une operation de flash prealable, une fois par carte.

CONFIG_WAMR_NODE_DEVICE_NAME="nucleo-wb55rg"
CONFIG_WAMR_NODE_DEVICE_TYPE="stm32wb55"
CONFIG_WAMR_NODE_OS_NAME="zephyr"

# Nom d'annonce BLE coherent avec l'identite.
CONFIG_BT_DEVICE_NAME="nucleo-wb55rg"

# --- Empreinte memoire WAMR reduite ---
# Le STM32WB55RG n'a que ~192 Ko de RAM applicative, dont une partie est
# consommee par la pile Bluetooth. Le pool WAMR par defaut (160 Ko) + les
# buffers ne rentrent pas (debordement RAM de ~114 Ko). On reduit donc au
# strict necessaire :
#  - pool 72 Ko : contient la memoire lineaire WASM (64 Ko incompressibles)
#    + les metadonnees WAMR (~8 Ko). C'est le plancher realiste ;
#  - binaire .wasm plafonne a 10 Ko (le module fait ~7 Ko) ;
#  - pile et tas d'execution reduits.
# Economie totale ~118 Ko : couvre le debordement de 114 Ko avec marge.
CONFIG_WAMR_APP_POOL_SIZE_KB=72
CONFIG_WAMR_APP_WASM_MAX_KB=10
CONFIG_WAMR_APP_STACK_KB=4
CONFIG_WAMR_APP_HEAP_KB=8

# Tas Zephyr (distinct du pool WAMR) : la valeur de prj.conf (64 Ko) est
# surdimensionnee pour le NUCLEO. On la reduit a 16 Ko pour degager de la
# marge RAM supplementaire. Le module de metriques n'alloue pas dynamiquement
# cote Zephyr, 16 Ko suffisent largement.
CONFIG_HEAP_MEM_POOL_SIZE=16384
```

## app.overlay
```dts
/*
 * app.overlay — Heltec WiFi LoRa 32 V3
 * LED onboard sur GPIO1 pin 35 (GPIO_NUM_35)
 */
/ {
    aliases {
        led0 = &user_led;
    };

    leds {
        compatible = "gpio-leds";
        user_led: led_0 {
            gpios = <&gpio1 3 GPIO_ACTIVE_HIGH>;
            label = "User LED";
        };
    };
};
```

## src/main.c
```c
/*
 * src/main.c — Firmware hote Zephyr generique, multi-transport (Wi-Fi / BLE)
 *
 * Reception d'un module .wasm puis execution, avec MISE A JOUR A CHAUD en
 * config Wi-Fi.
 *
 * MISE A JOUR A CHAUD (hot-update)
 * --------------------------------
 * Modele COOPERATIF a un seul fil d'execution :
 *   - la sonde WASM interroge periodiquement le reseau (host_poll_update) ;
 *   - si un nouveau .wasm arrive, il est recu dans un SECOND buffer (staging)
 *     et un drapeau est leve ;
 *   - la sonde, informee, sort proprement de sa boucle (return), sans etre
 *     interrompue en plein appel hote ;
 *   - le firmware reprend la main, DETRUIT l'instance WASM courante, bascule
 *     le buffer de staging en buffer courant, incremente update_count, puis
 *     charge et execute le nouveau module.
 *
 * Repli : si le nouveau module est invalide (chargement echoue), on ne fait
 * pas de rollback ; la carte retourne en attente d'un autre upload (elle
 * reste joignable). Le module fautif est simplement ignore.
 *
 * En CONFIG BLE (pas de CONFIG_WIFI), la mise a jour a chaud n'existe pas :
 * upload par UART, avec redemarrage, exactement comme avant.
 *
 * Licence : Apache-2.0
 */

#include <zephyr/kernel.h>
#include <zephyr/device.h>
#include <zephyr/drivers/uart.h>
#include <zephyr/sys/printk.h>
#include <string.h>

#include "wasm_export.h"
#include "host_api.h"
#include "deploy.h"

#if defined(CONFIG_WIFI)
#include "transport.h"
#include "net_upload.h"
#define UPLOAD_TCP_PORT      5555   /* port d'ecoute pour l'upload reseau */
#define WIFI_BRINGUP_SECS    20     /* delai max de montee du Wi-Fi au boot */
#endif

#define UART_NODE DT_CHOSEN(zephyr_console)

/* Tailles WAMR configurables par carte via Kconfig. */
#ifndef CONFIG_WAMR_APP_POOL_SIZE_KB
#define CONFIG_WAMR_APP_POOL_SIZE_KB 160
#endif
#ifndef CONFIG_WAMR_APP_WASM_MAX_KB
#define CONFIG_WAMR_APP_WASM_MAX_KB 40
#endif
#ifndef CONFIG_WAMR_APP_STACK_KB
#define CONFIG_WAMR_APP_STACK_KB 8
#endif
#ifndef CONFIG_WAMR_APP_HEAP_KB
#define CONFIG_WAMR_APP_HEAP_KB 16
#endif

#define WASM_MAX_SIZE  (CONFIG_WAMR_APP_WASM_MAX_KB  * 1024)
#define STACK_SIZE     (CONFIG_WAMR_APP_STACK_KB     * 1024)
#define HEAP_SIZE      (CONFIG_WAMR_APP_HEAP_KB      * 1024)
#define WAMR_POOL_SIZE (CONFIG_WAMR_APP_POOL_SIZE_KB * 1024)

/* --- Deux buffers d'octets (module courant + module en attente) -------------
 * On alterne les pointeurs g_cur / g_stage a chaque mise a jour : pas de copie,
 * juste un echange de pointeurs. Seuls des OCTETS coexistent, jamais deux
 * instances WASM.
 */
static uint8_t wasm_buf_a[WASM_MAX_SIZE];
static uint8_t wasm_buf_b[WASM_MAX_SIZE];
static uint8_t *g_cur   = wasm_buf_a;   /* module en cours d'execution */
static uint8_t *g_stage = wasm_buf_b;   /* module recu, en attente     */
static uint32_t g_cur_size;
static uint32_t g_stage_size;
static volatile bool g_pending;         /* un module attend d'etre charge */
static uint32_t g_update_count;         /* nb de mises a jour a chaud     */

static char wamr_pool[WAMR_POOL_SIZE] __aligned(8);

static const struct device *uart_dev;

/* ==========================================================================
 * Contrat de deploiement (declare dans deploy.h, appele par host_api.c).
 * ========================================================================== */

int deploy_try_stage(void)
{
#if defined(CONFIG_WIFI)
	if (g_pending) {
		return 1;   /* deja un module en attente : on n'en recoit pas un 2e */
	}
	uint32_t sz = 0;
	int r = net_upload_try(g_stage, WASM_MAX_SIZE, &sz);
	if (r == 1) {
		g_stage_size = sz;
		g_pending = true;
		return 1;
	}
#endif
	return 0;
}

int deploy_pending(void)
{
	return g_pending ? 1 : 0;
}

uint32_t deploy_update_count(void)
{
	return g_update_count;
}

/* --------------------------------------------------------------------------
 * Reception UART (inchangee) : protocole [taille(4 LE)][binaire].
 * -------------------------------------------------------------------------- */

static void uart_read_byte(const struct device *dev, uint8_t *out)
{
	while (uart_poll_in(dev, out) != 0) {
		k_yield();
	}
}

static void uart_drain_rx(const struct device *dev)
{
	uint8_t dummy;
	int rounds = 0;
	int drained;
	do {
		drained = 0;
		while (uart_poll_in(dev, &dummy) == 0) {
			drained++;
		}
		if (drained > 0) {
			k_msleep(300);
			rounds = 0;
		} else {
			rounds++;
			k_msleep(100);
		}
	} while (rounds < 5);
	printk("UART resync OK\n");
}

/* Recoit taille + corps a partir d'un premier octet DEJA lu, dans `dst`.
 * Retourne true si un module valide a ete recu.
 */
static bool uart_receive_module(const struct device *dev, uint8_t first,
				uint8_t *dst, uint32_t *size_out)
{
	uint32_t wasm_size = 0;
	((uint8_t *)&wasm_size)[0] = first;
	for (int i = 1; i < 4; i++) {
		uint8_t b;
		uart_read_byte(dev, &b);
		((uint8_t *)&wasm_size)[i] = b;
	}
	printk("Incoming size = %u bytes\n", wasm_size);

	if (wasm_size == 0 || wasm_size > WASM_MAX_SIZE) {
		printk("ERROR: invalid size (0 < size <= %d)\n", WASM_MAX_SIZE);
		uart_drain_rx(dev);
		return false;
	}

	for (uint32_t i = 0; i < wasm_size; i++) {
		uart_read_byte(dev, &dst[i]);
	}
	printk("Upload complete (%u bytes)\n", wasm_size);
	*size_out = wasm_size;
	return true;
}

/* --------------------------------------------------------------------------
 * Execution d'un module WASM. Retourne true si le module a ete charge et
 * execute (fin normale ou exception), false si le CHARGEMENT a echoue
 * (module invalide/corrompu) -> repli.
 *
 * NB : wasm_data est un uint8_t* NON const (wasm_runtime_load l'exige).
 * -------------------------------------------------------------------------- */

static bool execute_wasm(uint8_t *wasm_data, uint32_t wasm_size)
{
	char error_buf[128];
	wasm_module_t module = NULL;
	wasm_module_inst_t inst = NULL;
	wasm_exec_env_t exec_env = NULL;
	wasm_function_inst_t func = NULL;
	bool loaded = false;

	module = wasm_runtime_load(wasm_data, wasm_size,
				   error_buf, sizeof(error_buf));
	if (!module) {
		printk("LOAD ERROR: %s\n", error_buf);
		return false;   /* module invalide -> repli */
	}
	loaded = true;
	printk("Module charge OK\n");

	inst = wasm_runtime_instantiate(module, STACK_SIZE, HEAP_SIZE,
					error_buf, sizeof(error_buf));
	if (!inst) {
		printk("INSTANTIATE ERROR: %s\n", error_buf);
		goto unload;
	}
	printk("Instance creee OK\n");

	exec_env = wasm_runtime_create_exec_env(inst, STACK_SIZE);
	if (!exec_env) {
		printk("EXEC ENV FAILED\n");
		goto deinstantiate;
	}

	func = wasm_runtime_lookup_function(inst, "main");
	if (!func) {
		func = wasm_runtime_lookup_function(inst, "_start");
	}
	if (!func) {
		printk("point d'entree introuvable (main/_start)\n");
		goto destroy_env;
	}

	printk("Execution du module WASM...\n");
	if (!wasm_runtime_call_wasm(exec_env, func, 0, NULL)) {
		printk("EXCEPTION: %s\n", wasm_runtime_get_exception(inst));
	} else {
		printk("Execution terminee\n");
	}

destroy_env:
	wasm_runtime_destroy_exec_env(exec_env);
deinstantiate:
	wasm_runtime_deinstantiate(inst);
unload:
	wasm_runtime_unload(module);
	return loaded;
}

/* --------------------------------------------------------------------------
 * Cycle de vie d'execution avec mise a jour a chaud.
 *
 * Execute g_cur ; a la sortie de la sonde, si un module est en attente
 * (g_pending, leve par la sonde via host_poll_update), on bascule dessus et
 * on recommence. Sinon on rend la main (retour a l'attente d'un nouvel upload).
 * -------------------------------------------------------------------------- */

static void run_with_hot_update(void)
{
	bool keep = true;
	while (keep) {
		bool loaded = execute_wasm(g_cur, g_cur_size);

		if (g_pending) {
			/* Un module attend : on bascule (echange de pointeurs). */
			uint8_t *tmp = g_cur;
			g_cur = g_stage;
			g_stage = tmp;
			g_cur_size = g_stage_size;
			g_pending = false;
			g_update_count++;
			printk("\n[deploy] MISE A JOUR A CHAUD #%u (%u octets)\n",
			       g_update_count, g_cur_size);
			/* on boucle : execution du nouveau module */
		} else if (!loaded) {
			/* Module courant invalide et rien en attente : repli. */
			printk("[deploy] module invalide, retour en attente\n");
			keep = false;
		} else {
			/* Sonde terminee sans mise a jour (arret propre/erreur) :
			 * retour a l'attente d'un nouvel upload. */
			printk("\nWaiting upload...\n");
			keep = false;
		}
	}
}

/* --------------------------------------------------------------------------
 * Programme principal.
 * -------------------------------------------------------------------------- */

int main(void)
{
	printk("\n");
	printk("========================================================\n");
	printk(" Firmware WAMR multi-transport (Wi-Fi / BLE) + hot-update\n");
	printk("========================================================\n");

	RuntimeInitArgs init_args;
	memset(&init_args, 0, sizeof(init_args));
	init_args.mem_alloc_type = Alloc_With_Pool;
	init_args.mem_alloc_option.pool.heap_buf = wamr_pool;
	init_args.mem_alloc_option.pool.heap_size = sizeof(wamr_pool);

	if (!wasm_runtime_full_init(&init_args)) {
		printk("WAMR init failed\n");
		return -1;
	}
	printk("WAMR init OK (pool=%d KB)\n", WAMR_POOL_SIZE / 1024);

	host_set_pool(wamr_pool, sizeof(wamr_pool));
	host_reset_counter_init();

	if (!host_register_natives()) {
		return -1;
	}

	uart_dev = DEVICE_DT_GET(UART_NODE);
	if (!device_is_ready(uart_dev)) {
		printk("UART not ready\n");
		return -1;
	}

	bool net_ready = false;

#if defined(CONFIG_WIFI)
	/* Bootstrap reseau : on monte le Wi-Fi pour autoriser l'upload TCP. */
	printk("[boot] config Wi-Fi : montee du reseau pour l'upload...\n");
	if (transport_wifi_bring_up(WIFI_BRINGUP_SECS) == 0) {
		if (net_upload_init(UPLOAD_TCP_PORT) == 0) {
			net_ready = true;
			printk("[boot] upload reseau actif (port TCP %d)\n",
			       UPLOAD_TCP_PORT);
		}
	} else {
		printk("[boot] Wi-Fi indisponible : upload par UART uniquement\n");
	}
#endif

	printk("\n===== DEPLOYMENT — Metrics Edition (hot-update) =====\n");
	printk("Protocol : 4 bytes size (LE) + wasm binary\n");
	printk("Max size : %d bytes\n", WASM_MAX_SIZE);
#if defined(CONFIG_WIFI)
	printk("Voies    : %s\n", net_ready ? "UART + reseau (TCP)" : "UART");
	printk("Hot-update : %s\n", net_ready ? "actif (reseau)" : "inactif");
#else
	printk("Voies    : UART\n");
	printk("Hot-update : inactif (BLE)\n");
#endif

	/* Boucle d'attente du PREMIER module : UART puis, en Wi-Fi, reseau.
	 * Le module initial est recu dans le buffer courant g_cur. */
	while (1) {
		bool got = false;

		/* 1) UART : sondage non bloquant du premier octet. */
		uint8_t first;
		if (uart_poll_in(uart_dev, &first) == 0) {
			if (uart_receive_module(uart_dev, first,
						g_cur, &g_cur_size)) {
				got = true;
			}
		}

#if defined(CONFIG_WIFI)
		/* 2) Reseau : sondage court d'un client TCP (dans g_cur). */
		if (!got && net_ready) {
			uint32_t sz = 0;
			int r = net_upload_try(g_cur, WASM_MAX_SIZE, &sz);
			if (r == 1) {
				g_cur_size = sz;
				got = true;
			}
		}
#endif

		if (got) {
			/* Execution + mises a jour a chaud successives. */
			run_with_hot_update();
		} else {
#if defined(CONFIG_WIFI)
			if (!net_ready) {
				k_msleep(20);
			}
			/* Si net_ready, net_upload_try() a deja temporise (poll). */
#else
			k_msleep(20);
#endif
		}
	}

	return 0;
}
```

## src/deploy.h
```c
/*
 * Contrat de mise a jour a chaud (hot-update).
 *
 * Ces fonctions sont DEFINIES dans main.c (qui possede les deux buffers et le
 * compteur) et APPELEES par host_api.c (qui les expose au module WASM sous
 * forme de host functions). Cette indirection garde main.c proprietaire de
 * l'etat de deploiement, et host_api.c simple relais.
 *
 * Modele : point de sortie COOPERATIF. La sonde interroge periodiquement le
 * reseau via host_poll_update ; si un nouveau .wasm est recu et mis en attente
 * (staging), la sonde rend la main proprement (return) et le firmware bascule
 * sur le nouveau module. Jamais deux INSTANCES WASM simultanees : l'ancienne
 * est detruite avant le chargement de la nouvelle.
 *
 * En config BLE (pas de CONFIG_WIFI), deploy_try_stage renvoie toujours 0 :
 * la mise a jour a chaud n'existe pas, on reste sur l'upload UART + reset.
 *
 * Licence : Apache-2.0
 */

#ifndef WAMR_DEPLOY_H
#define WAMR_DEPLOY_H

#include <stdint.h>

/* Sonde le reseau (non bloquant) et, si un module complet arrive, le place
 * dans le buffer de staging et leve le drapeau d'attente.
 * Retourne 1 si un module est desormais en attente, 0 sinon.
 */
int deploy_try_stage(void);

/* Retourne 1 si un module recu attend d'etre charge, 0 sinon. */
int deploy_pending(void);

/* Nombre de mises a jour a chaud effectuees depuis le demarrage (metrique,
 * distincte de reset_count qui, lui, ne compte que les redemarrages materiels).
 */
uint32_t deploy_update_count(void);

#endif /* WAMR_DEPLOY_H */
```

## src/host_api.c
```c
/*
 * src/host_api.c — Couche hote WAMR, VARIANTE SIMULATION (Zephyr).
 *
 * OBJECTIF
 * --------
 * Faire tourner la VRAIE sonde .wasm (PADRE + CBOR, inchangee) sur un vrai
 * ESP32, mais en alimentant CPU et batterie avec des DONNEES SIMULEES
 * realistes, pour evaluer PADRE sans application reelle ni batterie physique :
 *
 *   - host_metric_cpu_usage  : REJOUE une trace CPU pre-generee (profil de
 *     l'equipement, calibree sur le dataset serre). C'est aussi ICI qu'on
 *     applique la decharge batterie du cycle (une lecture CPU = un cycle).
 *   - host_metric_battery_mv : BATTERIE SIMULEE en BOUCLE FERMEE. Elle NE LIT
 *     PAS l'ADC (toute logique ADC est outrepassee). Elle decroit selon
 *     E_base + E_cpu*cpu + E_tx*(octets REELLEMENT emis, lus dans
 *     g_tx_counters.bytes_tx). Le % est converti en mV pour que le cutoff PADRE
 *     (BATTERY_CUTOFF_MV) s'active et declenche le mode survie.
 *
 * Le reste (transport reseau, metriques reseau reelles : bytes_tx/rx, erreurs,
 * signal, durees) reste REEL et inchange. Le .wasm ignore que cpu/batterie sont
 * simules : la portabilite du contrat hote est preservee.
 *
 * PROFIL : choisi a la compilation par SIM_EQUIP_ID (0..4) :
 *   west build ... -- -DEXTRA_CONF_FILE=conf/wifi.conf -DSIM_EQUIP_ID=3
 * (necessite les 3 lignes CMake decrites dans le README de simulation).
 * Un firmware par equipement (flasher chaque carte avec un ID different).
 *
 * Licence : Apache-2.0
 */

#include <zephyr/kernel.h>
#include <zephyr/sys/printk.h>
#include <string.h>
#include <stdio.h>

#if defined(CONFIG_WIFI) && defined(CONFIG_NET_STATISTICS)
#include <zephyr/net/net_if.h>
#include <zephyr/net/net_stats.h>
#include <zephyr/net/net_mgmt.h>
#endif

#include "wasm_export.h"
#include "host_api.h"
#include "transport.h"

#include "traces_cpu.h"   /* tables de traces CPU (static const -> flash) */

/* ================================================================
 * SELECTION DU PROFIL D'EQUIPEMENT (a passer au build : -DSIM_EQUIP_ID=n)
 *   0 = stable          (batt0 90%)
 *   1 = montee_charge   (batt0 75%)
 *   2 = critique        (batt0 60%)
 *   3 = batterie_faible (batt0 30%)
 *   4 = nominal         (batt0 50%)
 * ================================================================ */
#ifndef SIM_EQUIP_ID
#define SIM_EQUIP_ID 0
#endif

/* Identite : type/os de l'equipement simule (fixes ici, non surchargeables). */
#define SIM_DEVICE_TYPE "esp32s3"
#define SIM_OS_NAME     "zephyr"

/* Nom d'equipement = "sim-<profil>" (ex. "sim-batterie_faible"). */
static char g_dev_name[40];

/* Pool WAMR (resolution de pointeur). */
static void *g_pool_base;
static size_t g_pool_size;
static uint32_t g_reset_count;

/* ================================================================
 * ETAT DE SIMULATION
 * ================================================================ */

/* Index courant dans la trace CPU (avance a chaque lecture CPU = chaque cycle). */
static uint32_t g_sim_idx;

/* Batterie simulee en 1e-5 % (0..10 000 000). Echelle fine -> arithmetique
 * entiere sans perte (consommations par cycle = quelques centaines d'unites). */
#define BATT_SCALE   100000               /* g_batt_hi = pct * 100000 */
static int32_t g_batt_hi;                 /* batterie, echelle 1e-5 %  */
static bool    g_batt_init;

/* Dernier compteur d'octets emis vu (pour le delta de transmission). */
static uint32_t g_last_bytes_tx;

/* --- Constantes energetiques CALIBREES (batt_constantes.json), en 1e-5 % ---
 * Modele : conso(cycle) = CONSO_BASE + CONSO_CPU*cpu + CONSO_TX_PER_OCTET*octets.
 *   base 0.0018 %/cycle           -> 180 (1e-5 %)
 *   cpu  0.00012 %/(cycle . %CPU)  -> 12  (1e-5 %) par % de CPU
 *   tx   derive de Heinzelman      -> 1   (1e-5 %) par octet emis
 * Le terme transmission est en BOUCLE FERMEE : octets REELLEMENT emis.
 * PADRE emettant moins -> batterie preservee. (Source : 3_calibrer_batterie.py) */
#define CONSO_BASE            180
#define CONSO_CPU             12
#define CONSO_TX_PER_OCTET    1

/* Conversion % simule -> mV. Mapping [3000..4200] : le cutoff PADRE
 * (BATTERY_CUTOFF_MV = 3300 mV) est franchi vers ~25 %, ce qui declenche le
 * mode survie AVANT que la batterie soit vide. */
#define SIM_MV_LOW   3000
#define SIM_MV_FULL  4200

void host_set_pool(void *pool, size_t size)
{
	g_pool_base = pool;
	g_pool_size = size;
}

void host_reset_counter_init(void)
{
	g_reset_count++;

	/* Init du nom d'equipement et de la batterie de depart. */
	const char *profil = sim_noms[SIM_EQUIP_ID];
	snprintf(g_dev_name, sizeof(g_dev_name), "sim-%s", profil);

	g_batt_hi = (int32_t)sim_batt0_pct[SIM_EQUIP_ID] * BATT_SCALE;
	g_batt_init = true;
	g_sim_idx = 0;
	g_last_bytes_tx = 0;

	printk("[sim] equipement %d = %s, batterie initiale %u%%\n",
	       SIM_EQUIP_ID, g_dev_name, sim_batt0_pct[SIM_EQUIP_ID]);
}

/* ----------------------------------------------------------------
 * Resolution de pointeur WASM -> natif
 * ---------------------------------------------------------------- */
static void *app_ptr(wasm_module_inst_t inst, uint32_t app_offset, uint32_t len)
{
	if (app_offset == 0 || len == 0) {
		return NULL;
	}
	if (wasm_runtime_validate_app_addr(inst, app_offset, len)) {
		return wasm_runtime_addr_app_to_native(inst, app_offset);
	}
	uintptr_t v = (uintptr_t)app_offset;
	if (g_pool_base &&
	    v >= (uintptr_t)g_pool_base &&
	    v + len <= (uintptr_t)g_pool_base + g_pool_size) {
		return (void *)v;
	}
	return NULL;
}

/* ================================================================
 * HOST FUNCTIONS — affichage
 * ================================================================ */
static void h_print(wasm_exec_env_t e, char *msg, uint32_t len)
{
	ARG_UNUSED(e);
	if (!msg || len == 0) {
		return;
	}
	char buf[192];
	uint32_t n = len < sizeof(buf) - 1 ? len : sizeof(buf) - 1;
	memcpy(buf, msg, n);
	buf[n] = '\0';
	printk("%s", buf);
}

/* ================================================================
 * HOST FUNCTIONS — transport abstrait (REEL, inchange)
 * ================================================================ */
static int32_t h_transport_connect(wasm_exec_env_t e,
	uint32_t ip_ptr, uint32_t ip_len, uint32_t port, uint32_t timeout)
{
	wasm_module_inst_t inst = wasm_runtime_get_module_inst(e);
	const char *ip = (const char *)app_ptr(inst, ip_ptr, ip_len);
	return (int32_t)transport_connect(ip ? ip : "", ip_len, port, timeout);
}
static int32_t h_transport_wait_ready(wasm_exec_env_t e, uint32_t timeout)
{
	ARG_UNUSED(e);
	return (int32_t)transport_wait_ready(timeout);
}
static int32_t h_transport_send(wasm_exec_env_t e, int32_t handle,
				uint32_t buf_ptr, uint32_t buf_len)
{
	wasm_module_inst_t inst = wasm_runtime_get_module_inst(e);
	const uint8_t *buf = (const uint8_t *)app_ptr(inst, buf_ptr, buf_len);
	if (!buf) {
		return -1;
	}
	return (int32_t)transport_send(handle, buf, buf_len);
}
static int32_t h_transport_recv(wasm_exec_env_t e, int32_t handle,
				uint32_t buf_ptr, uint32_t buf_len)
{
	wasm_module_inst_t inst = wasm_runtime_get_module_inst(e);
	uint8_t *buf = (uint8_t *)app_ptr(inst, buf_ptr, buf_len);
	if (!buf) {
		return -1;
	}
	return (int32_t)transport_recv(handle, buf, buf_len);
}
static void h_transport_close(wasm_exec_env_t e, int32_t handle)
{
	ARG_UNUSED(e);
	transport_close(handle);
}
static void h_sleep(wasm_exec_env_t e, uint32_t secs)
{
	ARG_UNUSED(e);
	if (secs > 0) {
		k_sleep(K_SECONDS(secs));
	}
}

/* ================================================================
 * HOT-UPDATE : desactive en simulation (pas de mise a jour pendant un test).
 * ================================================================ */
static int32_t h_poll_update(wasm_exec_env_t e)
{
	ARG_UNUSED(e);
	return 0;
}
static uint32_t h_update_count(wasm_exec_env_t e)
{
	ARG_UNUSED(e);
	return 0;
}

/* ================================================================
 * HOST FUNCTIONS — METRIQUES SIMULEES (CPU + batterie)
 * ================================================================ */

/* M1 — CPU : REJOUE la trace du profil. Avance l'index a chaque appel, et
 * applique la decharge batterie du cycle (boucle fermee).
 * En fin de trace (simulation > duree generee), maintient la derniere valeur. */
static uint32_t h_cpu_usage(wasm_exec_env_t e)
{
	ARG_UNUSED(e);
	uint32_t idx = g_sim_idx;
	if (idx >= SIM_N_POINTS) {
		idx = SIM_N_POINTS - 1;
	}
	uint8_t cpu = sim_cpu_traces[SIM_EQUIP_ID][idx];

	/* Decharge batterie de CE cycle (h_cpu_usage appele 1x/cycle). */
	{
		uint32_t tx_now = g_tx_counters.bytes_tx;
		uint32_t d_octets = tx_now - g_last_bytes_tx;
		g_last_bytes_tx = tx_now;

		int32_t conso = CONSO_BASE
			      + (int32_t)CONSO_CPU * (int32_t)cpu
			      + (int32_t)CONSO_TX_PER_OCTET * (int32_t)d_octets;
		g_batt_hi -= conso;
		if (g_batt_hi < 0) {
			g_batt_hi = 0;
		}
	}

	g_sim_idx++;
	return cpu;
}

/* M13 — batterie SIMULEE (mV). Outrepasse l'ADC : renvoie la batterie du
 * modele en boucle fermee, convertie en mV pour le cutoff PADRE. */
static uint32_t h_battery_mv(wasm_exec_env_t e)
{
	ARG_UNUSED(e);
	if (!g_batt_init) {
		return SIM_MV_FULL;
	}
	int32_t hi = g_batt_hi;                          /* 0..10 000 000 (1e-5 %) */
	if (hi > 100 * BATT_SCALE) hi = 100 * BATT_SCALE;
	if (hi < 0) hi = 0;

	int32_t mv = SIM_MV_LOW +
		     (int32_t)((int64_t)(SIM_MV_FULL - SIM_MV_LOW) * hi
			       / (100 * BATT_SCALE));
	return (uint32_t)mv;
}

/* ================================================================
 * HOST FUNCTIONS — metriques REELLES (inchangees)
 * ================================================================ */

static uint32_t h_free_heap(wasm_exec_env_t e)
{
	ARG_UNUSED(e);
	return (uint32_t)CONFIG_HEAP_MEM_POOL_SIZE;
}
static uint32_t h_uptime_ms(wasm_exec_env_t e)
{
	ARG_UNUSED(e);
	return (uint32_t)(k_uptime_get() & 0xFFFFFFFFULL);
}
static uint32_t h_bytes_tx(wasm_exec_env_t e)
{
	ARG_UNUSED(e);
	return g_tx_counters.bytes_tx;
}
static uint32_t h_bytes_rx(wasm_exec_env_t e)
{
	ARG_UNUSED(e);
	return g_tx_counters.bytes_rx;
}
static uint32_t h_transport_errors(wasm_exec_env_t e)
{
	ARG_UNUSED(e);
	return g_tx_counters.errors;
}
static uint32_t h_stack_usage_pct(wasm_exec_env_t e)
{
	ARG_UNUSED(e);
#if defined(CONFIG_INIT_STACKS) && defined(CONFIG_THREAD_STACK_INFO)
	struct k_thread *self = k_current_get();
	size_t unused = 0;
	if (k_thread_stack_space_get(self, &unused) != 0) {
		return 0;
	}
	size_t total = self->stack_info.size;
	if (total == 0 || unused > total) {
		return 0;
	}
	return (uint32_t)(((total - unused) * 100U) / total);
#else
	return 0;
#endif
}
static int32_t h_signal_dbm(wasm_exec_env_t e)
{
	ARG_UNUSED(e);
	return transport_signal_dbm();
}
static uint32_t h_reset_count(wasm_exec_env_t e)
{
	ARG_UNUSED(e);
	return g_reset_count;
}

/* M11 — threads actifs.
 * CORRECTION : en simulation, on renvoie une valeur fixe. On N'APPELLE PAS
 * k_thread_foreach avec un callback nul (cela provoquait un saut vers l'adresse
 * 0 -> "Illegal instruction, mepc: 0"). Cette metrique n'influence pas PADRE. */
static uint32_t h_active_threads(wasm_exec_env_t e)
{
	ARG_UNUSED(e);
	return 1;
}

static uint32_t h_tcp_retransmissions(wasm_exec_env_t e)
{
	ARG_UNUSED(e);
#if defined(CONFIG_NET_STATISTICS) && defined(CONFIG_NET_STATISTICS_TCP) && defined(CONFIG_WIFI)
	struct net_stats stats;
	struct net_if *iface = net_if_get_default();
	if (iface && net_mgmt(NET_REQUEST_STATS_GET_ALL, iface,
			      &stats, sizeof(stats)) == 0) {
		return (uint32_t)stats.tcp.rexmit;
	}
#endif
	return 0;
}

/* ================================================================
 * HOST FUNCTIONS — identite (equipement simule distinct)
 * ================================================================ */
static int32_t copy_id(char *buf, uint32_t cap, const char *val)
{
	if (!buf) {
		return -1;
	}
	size_t len = strlen(val);
	if (cap < len) {
		return -1;
	}
	memcpy(buf, val, len);
	return (int32_t)len;
}
static int32_t h_get_device_name(wasm_exec_env_t e, char *buf, uint32_t cap)
{
	ARG_UNUSED(e);
	return copy_id(buf, cap, g_dev_name);
}
static int32_t h_get_device_type(wasm_exec_env_t e, char *buf, uint32_t cap)
{
	ARG_UNUSED(e);
	return copy_id(buf, cap, SIM_DEVICE_TYPE);
}
static int32_t h_get_os_name(wasm_exec_env_t e, char *buf, uint32_t cap)
{
	ARG_UNUSED(e);
	return copy_id(buf, cap, SIM_OS_NAME);
}
static int32_t h_get_transport_name(wasm_exec_env_t e, char *buf, uint32_t cap)
{
	ARG_UNUSED(e);
	return copy_id(buf, cap, transport_name());
}

/* ================================================================
 * TABLE DES SYMBOLES NATIFS
 * IDENTIQUE (noms + signatures) au contrat du module .wasm (ffi.rs).
 * L'ORDRE et les SIGNATURES doivent correspondre exactement, sinon un appel
 * part vers une adresse invalide (crash "Illegal instruction, mepc: 0").
 * ================================================================ */
static NativeSymbol native_symbols[] = {
	{ "host_print",                 h_print,                 "(*~)",    NULL },

	{ "host_transport_connect",     h_transport_connect,     "(iiii)i", NULL },
	{ "host_transport_wait_ready",  h_transport_wait_ready,  "(i)i",    NULL },
	{ "host_transport_send",        h_transport_send,        "(iii)i",  NULL },
	{ "host_transport_recv",        h_transport_recv,        "(iii)i",  NULL },
	{ "host_transport_close",       h_transport_close,       "(i)",     NULL },
	{ "host_sleep",                 h_sleep,                 "(i)",     NULL },

	{ "host_poll_update",           h_poll_update,           "()i", NULL },
	{ "host_metric_update_count",   h_update_count,          "()i", NULL },

	{ "host_metric_cpu_usage",         h_cpu_usage,         "()i", NULL },
	{ "host_metric_free_heap",         h_free_heap,         "()i", NULL },
	{ "host_metric_uptime_ms",         h_uptime_ms,         "()i", NULL },
	{ "host_metric_bytes_tx",          h_bytes_tx,          "()i", NULL },
	{ "host_metric_bytes_rx",          h_bytes_rx,          "()i", NULL },
	{ "host_metric_transport_errors",  h_transport_errors,  "()i", NULL },
	{ "host_metric_stack_usage_pct",   h_stack_usage_pct,   "()i", NULL },
	{ "host_metric_signal_dbm",        h_signal_dbm,        "()i", NULL },
	{ "host_metric_reset_count",       h_reset_count,       "()i", NULL },
	{ "host_metric_active_threads",       h_active_threads,       "()i", NULL },
	{ "host_metric_tcp_retransmissions",  h_tcp_retransmissions,  "()i", NULL },
	{ "host_metric_battery_mv",           h_battery_mv,           "()i", NULL },

	{ "host_get_device_name",       h_get_device_name,       "(*~)i", NULL },
	{ "host_get_device_type",       h_get_device_type,       "(*~)i", NULL },
	{ "host_get_os_name",           h_get_os_name,           "(*~)i", NULL },
	{ "host_get_transport_name",    h_get_transport_name,    "(*~)i", NULL },
};

bool host_register_natives(void)
{
	uint32_t n = (uint32_t)(sizeof(native_symbols) / sizeof(native_symbols[0]));
	if (!wasm_runtime_register_natives("env", native_symbols, n)) {
		printk("[wamr] echec d'enregistrement des symboles natifs\n");
		return false;
	}
	printk("[wamr] %u symboles natifs enregistres (SIMULATION equip %d)\n",
	       n, SIM_EQUIP_ID);
	return true;
}
```

## src/host_api.h
```c
/*
 * src/host_api.h — Declarations de la couche hote WAMR
 *
 * Licence : Apache-2.0
 */

#ifndef WAMR_HOST_API_H
#define WAMR_HOST_API_H

#include <stdbool.h>
#include <stdint.h>

#include "wasm_export.h"

/* Enregistre la table des symboles natifs aupres de WAMR.
 * A appeler apres wasm_runtime_full_init() et avant tout chargement de
 * module. Retourne true en cas de succes.
 */
bool host_register_natives(void);

/* Renseigne les bornes du pool WAMR (resolution de pointeur en dernier
 * recours).
 */
void host_set_pool(void *pool, size_t size);

/* Compteur de redemarrages (M10). Incremente une fois au demarrage. */
void host_reset_counter_init(void);

#endif /* WAMR_HOST_API_H */
```

## src/net_upload.c
```c
/*
 * Reception d'un module .wasm par le reseau (TCP).
 *
 * Compile UNIQUEMENT en config Wi-Fi (#if defined(CONFIG_WIFI)). En build BLE,
 * ce fichier se reduit a du vide et n'introduit aucune dependance : l'upload
 * reseau n'existe que sur les cartes Wi-Fi, l'UART restant la seule voie en BLE.
 *
 * Le socket d'ecoute reste BLOQUANT ; on teste la presence d'un client avec
 * zsock_poll() (timeout court), ce qui evite tout reglage non bloquant et rend
 * la boucle d'attente de main.c reactive tant a l'UART qu'au reseau.
 *
 * Licence : Apache-2.0
 */

#include <zephyr/kernel.h>

#if defined(CONFIG_WIFI)

#include <zephyr/net/socket.h>
#include <zephyr/sys/printk.h>
#include <string.h>

#include "net_upload.h"

/* Duree du sondage de presence d'un client (ms). Sert aussi de rythme a la
 * boucle d'attente cote main.c. */
#define POLL_MS      50
/* Delai max de reception d'un transfert une fois le client connecte (s). */
#define RECV_TIMEOUT 15

static int listen_fd = -1;

int net_upload_init(uint16_t port)
{
	int fd = zsock_socket(AF_INET, SOCK_STREAM, IPPROTO_TCP);
	if (fd < 0) {
		printk("[upload] creation du socket d'ecoute echouee\n");
		return -1;
	}

	int yes = 1;
	zsock_setsockopt(fd, SOL_SOCKET, SO_REUSEADDR, &yes, sizeof(yes));

	struct sockaddr_in addr = {0};
	addr.sin_family = AF_INET;
	addr.sin_addr.s_addr = htonl(INADDR_ANY);
	addr.sin_port = htons(port);

	if (zsock_bind(fd, (struct sockaddr *)&addr, sizeof(addr)) < 0) {
		printk("[upload] bind sur le port %u echoue\n", port);
		zsock_close(fd);
		return -1;
	}
	if (zsock_listen(fd, 1) < 0) {
		printk("[upload] listen echoue\n");
		zsock_close(fd);
		return -1;
	}

	listen_fd = fd;
	return 0;
}

static int recv_all(int fd, uint8_t *buf, uint32_t n)
{
	uint32_t got = 0;
	while (got < n) {
		int r = zsock_recv(fd, buf + got, n - got, 0);
		if (r <= 0) {
			return -1;
		}
		got += (uint32_t)r;
	}
	return 0;
}

int net_upload_try(uint8_t *buf, uint32_t max_size, uint32_t *out_size)
{
	if (listen_fd < 0) {
		return 0;
	}

	/* Un client est-il en attente ? (sondage court, non bloquant en pratique) */
	struct zsock_pollfd pfd = {
		.fd = listen_fd,
		.events = ZSOCK_POLLIN,
	};
	int pr = zsock_poll(&pfd, 1, POLL_MS);
	if (pr <= 0 || !(pfd.revents & ZSOCK_POLLIN)) {
		return 0;   /* aucun client */
	}

	struct sockaddr_in cli;
	socklen_t clen = sizeof(cli);
	int cfd = zsock_accept(listen_fd, (struct sockaddr *)&cli, &clen);
	if (cfd < 0) {
		return 0;
	}
	printk("[upload] client reseau connecte\n");

	struct zsock_timeval tv = {.tv_sec = RECV_TIMEOUT, .tv_usec = 0};
	zsock_setsockopt(cfd, SOL_SOCKET, SO_RCVTIMEO, &tv, sizeof(tv));

	/* 1) taille sur 4 octets (little-endian, identique a l'UART) */
	uint8_t hdr[4];
	if (recv_all(cfd, hdr, 4) != 0) {
		printk("[upload] taille non recue\n");
		zsock_close(cfd);
		return -1;
	}
	uint32_t size = (uint32_t)hdr[0] |
			((uint32_t)hdr[1] << 8) |
			((uint32_t)hdr[2] << 16) |
			((uint32_t)hdr[3] << 24);

	if (size == 0 || size > max_size) {
		printk("[upload] taille invalide : %u (max %u)\n", size, max_size);
		zsock_close(cfd);
		return -1;
	}
	printk("[upload] reception reseau de %u octets...\n", size);

	/* 2) binaire */
	if (recv_all(cfd, buf, size) != 0) {
		printk("[upload] transfert reseau incomplet\n");
		zsock_close(cfd);
		return -1;
	}

	(void)zsock_send(cfd, "OK", 2, 0);
	zsock_close(cfd);

	*out_size = size;
	printk("[upload] module recu par reseau (%u octets)\n", size);
	return 1;
}

void net_upload_stop(void)
{
	if (listen_fd >= 0) {
		zsock_close(listen_fd);
		listen_fd = -1;
	}
}

#endif /* CONFIG_WIFI */
```

## src/net_upload.h
```c
/*
 * Reception d'un module .wasm par le reseau (TCP).
 *
 * Uniquement pertinent en config Wi-Fi. Les fonctions ne sont definies que
 * dans net_upload.c sous #if defined(CONFIG_WIFI) ; main.c ne les appelle que
 * sous la meme garde, donc aucun lien n'est requis en build BLE.
 *
 * Protocole (identique a l'UART) : 4 octets de taille (uint32 little-endian)
 * suivis du binaire .wasm. Le serveur repond "OK" a la fin.
 *
 * Licence : Apache-2.0
 */

#ifndef WAMR_NET_UPLOAD_H
#define WAMR_NET_UPLOAD_H

#include <stdint.h>

/* Ouvre le socket TCP d'ecoute sur le port donne. Retourne 0 si OK, -1 sinon. */
int net_upload_init(uint16_t port);

/* Verifie (sans bloquer longuement) si un client pousse un module.
 *   - retourne 1 si un module complet a ete recu dans `buf` (*out_size rempli) ;
 *   - retourne 0 si aucun client ne s'est presente ;
 *   - retourne -1 en cas de transfert errone (a ignorer, on reessaie).
 */
int net_upload_try(uint8_t *buf, uint32_t max_size, uint32_t *out_size);

/* Ferme le socket d'ecoute (optionnel). */
void net_upload_stop(void);

#endif /* WAMR_NET_UPLOAD_H */
```

## src/transport.h
```c
/*
 * src/transport.h — Interface de transport abstrait pour le firmware WAMR
 *
 * OBJECTIF
 * --------
 * Definir un contrat de transport UNIQUE, implemente par deux backends
 * interchangeables :
 *   - transport_wifi.c  (Wi-Fi + TCP)   compile si CONFIG_WIFI est actif
 *   - transport_ble.c   (BLE + NUS)     compile si CONFIG_BT  est actif
 *
 * Le reste du firmware (main.c, couche hote WAMR) ne connait QUE cette
 * interface : il ignore totalement quel backend est derriere.
 *
 * MISE A JOUR (upload reseau)
 * ---------------------------
 * Ajout de deux fonctions PROPRES AU BACKEND Wi-Fi, utilisees uniquement pour
 * la phase d'upload reseau du module .wasm (voir net_upload.c / main.c) :
 *   - transport_wifi_bring_up() : monte le Wi-Fi (association + IP) AVANT
 *     l'execution de la sonde, afin de pouvoir recevoir le .wasm par TCP ;
 *   - transport_wifi_is_up()    : indique si le Wi-Fi est deja monte.
 * Ces symboles ne sont definis que par transport_wifi.c ; main.c ne les
 * appelle que sous #if defined(CONFIG_WIFI), donc aucun lien n'est requis en
 * build BLE.
 *
 * Licence : Apache-2.0
 */

#ifndef WAMR_TRANSPORT_H
#define WAMR_TRANSPORT_H

#include <zephyr/kernel.h>
#include <stdint.h>
#include <stddef.h>
#include <stdbool.h>

/* Nom du transport actif, expose au module WASM via host_get_transport_name. */
extern const char *transport_name(void);

/* Compteurs de transmission cumules, communs a tous les backends. */
struct transport_counters {
	uint32_t bytes_tx;        /* M4 */
	uint32_t bytes_rx;        /* M5 */
	uint32_t errors;          /* M6 */
};
extern struct transport_counters g_tx_counters;

/* Etablit le transport. Retourne un descripteur logique >= 0, ou -1. */
int transport_connect(const char *ip, size_t ip_len,
		      uint32_t port, uint32_t timeout_secs);

/* Attend que le transport soit pret a transmettre. 0 si pret, -1 sur timeout. */
int transport_wait_ready(uint32_t timeout_secs);

/* Emet un bloc de donnees. Retourne le nombre d'octets emis, ou < 0. */
int transport_send(int handle, const uint8_t *buf, uint32_t len);

/* Recoit un bloc (ACK applicatif). >=0 octets, < 0 en cas d'erreur. */
int transport_recv(int handle, uint8_t *buf, uint32_t len);

/* Ferme le transport. */
void transport_close(int handle);

/* RSSI courant en dBm. 0 si indisponible. */
int32_t transport_signal_dbm(void);

/* ---- Specifique Wi-Fi : bring-up pour l'upload reseau ---------------------
 * Definis uniquement dans transport_wifi.c (CONFIG_WIFI). En build BLE, main.c
 * ne les appelle pas (gardes #if defined(CONFIG_WIFI)).
 */
int transport_wifi_bring_up(uint32_t timeout_secs);
bool transport_wifi_is_up(void);

#endif /* WAMR_TRANSPORT_H */
```
